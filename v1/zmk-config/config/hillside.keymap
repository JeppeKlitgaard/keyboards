#include <behaviors.dtsi>
#include <dt-bindings/zmk/bt.h>
#include <dt-bindings/zmk/ext_power.h>
#include <dt-bindings/zmk/keys.h>
#include <dt-bindings/zmk/outputs.h>

#include "layers.dtsi"
#include "my_behaviors.dtsi"
#include "customisations.dtsi"

/ {
};
