#include "my_behaviors.dtsi"
#include "homerow_mods.dtsi"
#include "greek.dtsi"

#include "zmk-helpers/key-labels/hillside52.h"

#include "zmk-helpers/unicode-chars/danish.dtsi"
#include "zmk-helpers/unicode-chars/greek.dtsi"

#define XXX &none
#define ___ &trans

// Alpha-like layers
#define L_BASE 0
#define L_GREEK 1
#define L_GREEK_VAR 2

// Right hand layers
#define L_NUM 3
#define L_NAV 4

// Left hand layers
#define L_SYM 5
#define L_MATH 6
#define L_BOARD 7
#define L_EMPTY 8

// TODO:
// Danish
// Macro
// Media
// Buttons

//! =======================================================================================================================================================================================================================================================================================================================================================
//! OVERVIEW OF LAYER KEYS
//! =======================================================================================================================================================================================================================================================================================================================================================
/*
╭─────────┬─────────┬─────────┬─────────┬─────────┬─────────╮                                             ╭─────────┬─────────┬─────────┬─────────┬─────────┬─────────╮
│         │         │         │         │         │         │                                             │         │         │         │         │         │         │
├─────────┼─────────┼─────────┼─────────┼─────────┼─────────┤                                             ┼─────────┼─────────┼─────────├─────────┼─────────┼─────────┼
│         │         │         │         │         │         │                                             │         │         │         │         │         │         │
├─────────┼─────────┼─────────┼─────────┼─────────┼─────────┼─────────╮                         ╭─────────┼─────────┼─────────┼─────────├─────────┼─────────┼─────────┼
│         │         │         │         │         │         │  GREEK  │                         |  BOARD  │         │         │         │         │         │         │
├─────────┼─────────┼─────────┼─────────┼─────────┼─────────┼─────────┼─────────╮     ╭─────────┼─────────┼─────────┼─────────┼─────────├─────────┼─────────┼─────────┼
│         │         │         │         │         │         │   NUM   │   NAV   │     │  MATH   │   SYM   ┼         │         │         │         │         │         │
╰─────────┴─────────┴─────────╯         ╰─────────┴─────────┴─────────┴─────────╯     ╰─────────┴─────────┴─────────┴─────────╯         ╰─────────┴─────────┴─────────╯
*/

//! =======================================================================================================================================================================================================================================================================================================================================================
//! ALPHA-LIKE LAYERS
//! =======================================================================================================================================================================================================================================================================================================================================================
//* Base – Gallium
/*
╭─────────┬─────────┬─────────┬─────────┬─────────┬─────────╮                                             ╭─────────┬─────────┬─────────┬─────────┬─────────┬─────────╮
│         │    B    │    L    │    D    │    C    │    V    │                                             │    J    │    Y    │    O    │    U    │    ,    │    Æ    │
├─────────┼─────────┼─────────┼─────────┼─────────┼─────────┤                                             ┼─────────┼─────────┼─────────├─────────┼─────────┼─────────┼
│         │    N    │    R    │    T    │    S    │    G    │                                             │    P    │    H    │    A    │    E    │    I    │    Å    │
├─────────┼─────────┼─────────┼─────────┼─────────┼─────────┼─────────╮                         ╭─────────┼─────────┼─────────┼─────────├─────────┼─────────┼─────────┼
│         │    X    │    Q    │    M    │    W    │    Z    │         │                         │         │    K    │    F    │    '    │    ;    │    .    │    Ø    │
├─────────┼─────────┼─────────┼─────────┼─────────┼─────────┼─────────┼─────────╮     ╭─────────┼─────────┼─────────┼─────────┼─────────├─────────┼─────────┼─────────┼
│         │         │         │         │         │   ESC   │  SPACE  │   TAB   │     │  ENTER  │  BSPC   │   DEL   │         │         │         │         │         │
╰─────────┴─────────┴─────────╯         ╰─────────┴─────────┴─────────┴─────────╯     ╰─────────┴─────────┴─────────┴─────────╯         ╰─────────┴─────────┴─────────╯
*/
ZMK_LAYER(base_layer,
// ╭────────────────────┬────────────────────┬────────────────────┬────────────────────┬────────────────────┬────────────────────╮                                                                                         ╭────────────────────┬────────────────────┬────────────────────┬────────────────────┬────────────────────┬────────────────────╮
     XXX                  &kp B                &kp L                &kp D                &kp C                &kp V                                                                                                          &kp J                &kp Y                &kp O                &kp U                &kp COMMA            &da_ae
// ├────────────────────┼────────────────────┼────────────────────┼────────────────────┼────────────────────┼────────────────────┤                                                                                         ┼────────────────────┼────────────────────┼────────────────────├────────────────────┼────────────────────┼────────────────────┼
     XXX                  &hml LGUI N          &hml LALT R          &hml LCTRL T         &hml LSHIFT S        &kp G                                                                                                          &kp P                &hmr RSHIFT H        &hmr RCTRL A         &hmr RALT E          &hmr RGUI I          &da_aa
// ├────────────────────┼────────────────────┼────────────────────┼────────────────────┼────────────────────┼────────────────────┼────────────────────╮                                               ╭────────────────────┼────────────────────┼────────────────────┼────────────────────├────────────────────┼────────────────────┼────────────────────┼
     XXX                  &kp X                &kp Q                &kp M                &kp W                &kp Z                &sl L_GREEK                                                          &mo L_BOARD          &kp K                &kp F                &kp SINGLE_QUOTE     &kp SEMICOLON        &kp PERIOD           &da_oe
// ├────────────────────┼────────────────────┼────────────────────┼────────────────────┼────────────────────┼────────────────────┼────────────────────┼────────────────────╮     ╭────────────────────┼────────────────────┼────────────────────┼────────────────────┼────────────────────├────────────────────┼────────────────────┼────────────────────┼
     XXX                  XXX                  XXX                                       XXX                  &kp ESCAPE           &lt L_NUM SPACE      &lt L_NAV TAB              &lt L_MATH ENTER     &lt L_SYM BACKSPACE  &kp DELETE           XXX                                       XXX                  XXX                  XXX
// ╰────────────────────┴────────────────────┴────────────────────╯                    ╰────────────────────┴────────────────────┴────────────────────┴────────────────────╯     ╰────────────────────┴────────────────────┴────────────────────┴────────────────────╯                    ╰────────────────────┴────────────────────┴────────────────────╯
)

//* Greek – Gallium
/*
╭─────────┬─────────┬─────────┬─────────┬─────────┬─────────╮                                             ╭─────────┬─────────┬─────────┬─────────┬─────────┬─────────╮
│         │  B=β,Β  │  L=λ,Λ  │  D=δ,Δ  │  C=ξ,Ξ  │ VARIANT │                                             │         │  Y=ψ,Ψ  │  O=ο,Ο  │  U=υ,Υ  │         │         │
├─────────┼─────────┼─────────┼─────────┼─────────┼─────────┤                                             ┼─────────┼─────────┼─────────├─────────┼─────────┼─────────┼
│         │  N=ν,Ν  │  R=ρ,Ρ  │  T=τ,Τ  │  S=σ,Σ  │  G=γ,Γ  │                                             │  P=π,Π  │  H=η,Η  │  A=α,Α  │  E=ε,Ε  │  I=ι,Ι  │         │
├─────────┼─────────┼─────────┼─────────┼─────────┼─────────┼─────────╮                         ╭─────────┼─────────┼─────────┼─────────├─────────┼─────────┼─────────┼
│         │  X=χ,Χ  │  Q=θ,Θ  │  M=μ,Μ  │  W=ω,Ω  │  Z=ζ,Ζ  │         │                         │         │  K=κ,Κ  │  F=φ,Φ  │         │         │         │         │
├─────────┼─────────┼─────────┼─────────┼─────────┼─────────┼─────────┼─────────╮     ╭─────────┼─────────┼─────────┼─────────┼─────────├─────────┼─────────┼─────────┼
│         │         │         │         │         │   ESC   │  SPACE  │   TAB   │     │  ENTER  │  BSPC   │   DEL   │         │         │         │         │         │
╰─────────┴─────────┴─────────╯         ╰─────────┴─────────┴─────────┴─────────╯     ╰─────────┴─────────┴─────────┴─────────╯         ╰─────────┴─────────┴─────────╯
*/
ZMK_LAYER(greek_layer,
// ╭────────────────────┬────────────────────┬────────────────────┬────────────────────┬────────────────────┬────────────────────╮                                                                                         ╭────────────────────┬────────────────────┬────────────────────┬────────────────────┬────────────────────┬────────────────────╮
     XXX                  &el_beta             &el_lambda           &el_delta            &el_xi               &sl L_GREEK_VAR                                                                                                XXX                  &el_psi              &el_omikron          &el_upsilon          XXX                  XXX
// ├────────────────────┼────────────────────┼────────────────────┼────────────────────┼────────────────────┼────────────────────┤                                                                                         ┼────────────────────┼────────────────────┼────────────────────├────────────────────┼────────────────────┼────────────────────┼
     XXX                  &el_nu               &el_rho              &el_tau              &hml_greek LSHIFT 0  &el_gamma                                                                                                      &el_pi               &hmr_greek RSHIFT 0  &el_alpha            &el_epsilon          &el_iota             XXX
// ├────────────────────┼────────────────────┼────────────────────┼────────────────────┼────────────────────┼────────────────────┼────────────────────╮                                               ╭────────────────────┼────────────────────┼────────────────────┼────────────────────├────────────────────┼────────────────────┼────────────────────┼
     XXX                  &el_chi              &el_theta            &el_mu               &el_omega            &el_zeta             XXX                                                                  XXX                  &el_kappa            &el_phi              XXX                  XXX                  XXX                  XXX
// ├────────────────────┼────────────────────┼────────────────────┼────────────────────┼────────────────────┼────────────────────┼────────────────────┼────────────────────╮     ╭────────────────────┼────────────────────┼────────────────────┼────────────────────┼────────────────────├────────────────────┼────────────────────┼────────────────────┼
     XXX                  XXX                  XXX                                       XXX                  XXX                  &kp SPACE            XXX                        XXX                  XXX                  XXX           XXX                                       XXX                  XXX                  XXX
// ╰────────────────────┴────────────────────┴────────────────────╯                    ╰────────────────────┴────────────────────┴────────────────────┴────────────────────╯     ╰────────────────────┴────────────────────┴────────────────────┴────────────────────╯                    ╰────────────────────┴────────────────────┴────────────────────╯
)

//* Greek Variants – Gallium
/*
╭─────────┬─────────┬─────────┬─────────┬─────────┬─────────╮                                             ╭─────────┬─────────┬─────────┬─────────┬─────────┬─────────╮
│         │         │         │         │         │         │                                             │         │         │         │         │         │         │
├─────────┼─────────┼─────────┼─────────┼─────────┼─────────┤                                             ┼─────────┼─────────┼─────────├─────────┼─────────┼─────────┼
│         │         │  R=ϱ,Ρ  │         │  S=ς,Σ  │         │                                             │  P=ϖ,Ω  │         │         │  E=ϵ,Ε  │         │         │
├─────────┼─────────┼─────────┼─────────┼─────────┼─────────┼─────────╮                         ╭─────────┼─────────┼─────────┼─────────├─────────┼─────────┼─────────┼
│         │         │  Q=ϑ,Θ  │         │         │         │         │                         │         │  K=ϰ,Κ  │  F=ϕ,Φ  │         │         │         │         │
├─────────┼─────────┼─────────┼─────────┼─────────┼─────────┼─────────┼─────────╮     ╭─────────┼─────────┼─────────┼─────────┼─────────├─────────┼─────────┼─────────┼
│         │         │         │         │         │         │  SPACE  │         │     │         │         │         │         │         │         │         │         │
╰─────────┴─────────┴─────────╯         ╰─────────┴─────────┴─────────┴─────────╯     ╰─────────┴─────────┴─────────┴─────────╯         ╰─────────┴─────────┴─────────╯
*/
ZMK_LAYER(greek_var_layer,
// ╭────────────────────┬────────────────────┬────────────────────┬────────────────────┬────────────────────┬────────────────────╮                                                                                         ╭────────────────────┬────────────────────┬────────────────────┬────────────────────┬────────────────────┬────────────────────╮
     XXX                  XXX                  XXX                  XXX                  XXX                  XXX                                                                                                            XXX                  XXX                  XXX                  XXX                  XXX                  XXX
// ├────────────────────┼────────────────────┼────────────────────┼────────────────────┼────────────────────┼────────────────────┤                                                                                         ┼────────────────────┼────────────────────┼────────────────────├────────────────────┼────────────────────┼────────────────────┼
     XXX                  XXX                  &el_rho_sym          XXX                  &hml_greek_var LSHIFT 0   XXX                                                                                                       &el_pi_sym           XXX                  XXX                  &el_epsilon_sym      XXX                  XXX
// ├────────────────────┼────────────────────┼────────────────────┼────────────────────┼────────────────────┼────────────────────┼────────────────────╮                                               ╭────────────────────┼────────────────────┼────────────────────┼────────────────────├────────────────────┼────────────────────┼────────────────────┼
     XXX                  XXX                  &el_final_sigma      XXX                  XXX                  XXX                  XXX                                                                  XXX                  &el_kappa_sym        &el_phi_sym          XXX                  XXX                  XXX                  XXX
// ├────────────────────┼────────────────────┼────────────────────┼────────────────────┼────────────────────┼────────────────────┼────────────────────┼────────────────────╮     ╭────────────────────┼────────────────────┼────────────────────┼────────────────────┼────────────────────├────────────────────┼────────────────────┼────────────────────┼
     XXX                  XXX                  XXX                                       XXX                  XXX                  &kp SPACE            XXX                        XXX                  XXX                  XXX                  XXX                                       XXX                  XXX                  XXX
// ╰────────────────────┴────────────────────┴────────────────────╯                    ╰────────────────────┴────────────────────┴────────────────────┴────────────────────╯     ╰────────────────────┴────────────────────┴────────────────────┴────────────────────╯                    ╰────────────────────┴────────────────────┴────────────────────╯
)

//! =======================================================================================================================================================================================================================================================================================================================================================
//! RIGHT HAND LAYERS
//! =======================================================================================================================================================================================================================================================================================================================================================
//* Numbers
/*
╭─────────┬─────────┬─────────┬─────────┬─────────┬─────────╮                                             ╭─────────┬─────────┬─────────┬─────────┬─────────┬─────────╮
│         │         │         │         │         │         │                                             │         │    7    │    8    │    9    │         │         │
├─────────┼─────────┼─────────┼─────────┼─────────┼─────────┤                                             ┼─────────┼─────────┼─────────┼─────────┼─────────┼─────────┼
│         │   GUI   │   ALT   │  CTRL   │  SHIFT  │         │                                             │         │    4    │    5    │    6    │         │         │
├─────────┼─────────┼─────────┼─────────┼─────────┼─────────┼─────────╮                         ╭─────────┼─────────┼─────────┼─────────┼─────────┼─────────┼─────────┼
│         │         │         │         │         │         │         │                         │         │         │    1    │    2    │    3    │         │         │
├─────────┼─────────┼─────────┼─────────┼─────────┼─────────┼─────────┼─────────╮     ╭─────────┼─────────┼─────────┼─────────┼─────────├─────────┼─────────┼─────────┼
│         │         │         │         │         │         ┼┼┼┼┼┼┼┼┼┼┼         │     │         │  ENTER  │    0    │         │         │         │         │         │
╰─────────┴─────────┴─────────╯         ╰─────────┴─────────┴─────────┴─────────╯     ╰─────────┴─────────┴─────────┴─────────╯         ╰─────────┴─────────┴─────────╯
*/
ZMK_LAYER(num_layer,
// ╭────────────────────┬────────────────────┬────────────────────┬────────────────────┬────────────────────┬────────────────────╮                                                                                         ╭────────────────────┬────────────────────┬────────────────────┬────────────────────┬────────────────────┬────────────────────╮
     XXX                  XXX                  XXX                  XXX                  XXX                  XXX                                                                                                            XXX                  &kp N7               &kp N8               &kp N9               XXX                  XXX
// ├────────────────────┼────────────────────┼────────────────────┼────────────────────┼────────────────────┼────────────────────┤                                                                                         ┼────────────────────┼────────────────────┼────────────────────┼────────────────────┼────────────────────┼────────────────────┼
     XXX                  &kp LGUI             &kp LALT             &kp LCTRL            &kp LSHIFT           XXX                                                                                                            XXX                  &kp N4               &kp N5               &kp N6               XXX                  XXX
// ├────────────────────┼────────────────────┼────────────────────┼────────────────────┼────────────────────┼────────────────────┼────────────────────╮                                               ╭────────────────────┼────────────────────┼────────────────────┼────────────────────┼────────────────────┼────────────────────┼────────────────────┼
     XXX                  XXX                  XXX                  XXX                  XXX                  XXX                  XXX                                                                  XXX                  XXX                  &kp N1               &kp N2               &kp N3               XXX                  XXX
// ├────────────────────┼────────────────────┼────────────────────┼────────────────────┼────────────────────┼────────────────────┼────────────────────┼────────────────────╮     ╭────────────────────┼────────────────────┼────────────────────┼────────────────────┼────────────────────├────────────────────┼────────────────────┼────────────────────┼
     XXX                  XXX                  XXX                                       XXX                  XXX                  XXX                  XXX                        &kp ENTER            &kp N0               XXX                  XXX                                       XXX                  XXX                  XXX
// ╰────────────────────┴────────────────────┴────────────────────╯                    ╰────────────────────┴────────────────────┴────────────────────┴────────────────────╯     ╰────────────────────┴────────────────────┴────────────────────┴────────────────────╯                    ╰────────────────────┴────────────────────┴────────────────────╯
)

//* Navigation
/*
╭─────────┬─────────┬─────────┬─────────┬─────────┬─────────╮                                             ╭─────────┬─────────┬─────────┬─────────┬─────────┬─────────╮
│         │         │         │         │         │         │                                             │         │  LC(←)  │  LC(↓)  │  LC(↑)  │  LC(→)  │         │
├─────────┼─────────┼─────────┼─────────┼─────────┼─────────┤                                             ┼─────────┼─────────┼─────────├─────────┼─────────┼─────────┼
│         │   GUI   │   ALT   │  CTRL   │  SHIFT  │         │                                             │         │    ←    │     ↓   │    ↑    │    →    │         │
├─────────┼─────────┼─────────┼─────────┼─────────┼─────────┼─────────╮                         ╭─────────┼─────────┼─────────┼─────────├─────────┼─────────┼─────────┼
│         │         │         │         │         │         │         │                         │         │         │  HOME   │ PG_DOWN │  PG_UP  │   END   │         │
├─────────┼─────────┼─────────┼─────────┼─────────┼─────────┼─────────┼─────────╮     ╭─────────┼─────────┼─────────┼─────────┼─────────├─────────┼─────────┼─────────┼
│         │         │         │         │         │         ┼         ┼|||||||||│     │         │  ENTER  │  BSPC   │   DEL   │         │         │         │         │
╰─────────┴─────────┴─────────╯         ╰─────────┴─────────┴─────────┴─────────╯     ╰─────────┴─────────┴─────────┴─────────╯         ╰─────────┴─────────┴─────────╯
*/
ZMK_LAYER(nav_layer,
// ╭────────────────────┬────────────────────┬────────────────────┬────────────────────┬────────────────────┬────────────────────╮                                                                                         ╭────────────────────┬────────────────────┬────────────────────┬────────────────────┬────────────────────┬────────────────────╮
     XXX                  XXX                  XXX                  XXX                  XXX                  XXX                                                                                                            XXX                  &kp LC(LEFT)         &kp LC(DOWN)         &kp LC(UP)           &kp LC(RIGHT)        XXX
// ├────────────────────┼────────────────────┼────────────────────┼────────────────────┼────────────────────┼────────────────────┤                                                                                         x┼────────────────────┼────────────────────┼────────────────────├────────────────────┼────────────────────┼────────────────────┼
     XXX                  &kp LGUI             &kp LALT             &kp LCTRL            &kp LSHIFT           XXX                                                                                                            XXX                  &kp LEFT             &kp DOWN             &kp UP               &kp RIGHT            XXX
// ├────────────────────┼────────────────────┼────────────────────┼────────────────────┼────────────────────┼────────────────────┼────────────────────╮                                               ╭────────────────────┼────────────────────┼────────────────────┼────────────────────├────────────────────┼────────────────────┼────────────────────┼
     XXX                  XXX                  XXX                  XXX                  XXX                  XXX                  XXX                                                                  XXX                  XXX                  &kp HOME             &kp PAGE_DOWN        &kp PAGE_UP          &kp END              XXX
// ├────────────────────┼────────────────────┼────────────────────┼────────────────────┼────────────────────┼────────────────────┼────────────────────┼────────────────────╮     ╭────────────────────┼────────────────────┼────────────────────┼────────────────────┼────────────────────├────────────────────┼────────────────────┼────────────────────┼
     XXX                  XXX                  XXX                                       XXX                  XXX                  XXX                  XXX                        &kp ENTER            &kp BACKSPACE        &kp DELETE           XXX                                       XXX                  XXX                  XXX
// ╰────────────────────┴────────────────────┴────────────────────╯                    ╰────────────────────┴────────────────────┴────────────────────┴────────────────────╯     ╰────────────────────┴────────────────────┴────────────────────┴────────────────────╯                    ╰────────────────────┴────────────────────┴────────────────────╯
)

//! =======================================================================================================================================================================================================================================================================================================================================================
//! LEFT HAND LAYERS
//! =======================================================================================================================================================================================================================================================================================================================================================
//* Symbols
// Inspiration: https://getreuer.info/posts/keyboards/symbol-layer/index.html#my-symbol-layer
/*
╭─────────┬─────────┬─────────┬─────────┬─────────┬─────────╮                                             ╭─────────┬─────────┬─────────┬─────────┬─────────┬─────────╮
│         │    ?    │    [    │    ]    │    :    │    $    │                                             │         │         │         │         │         │         │
├─────────┼─────────┼─────────┼─────────┼─────────┼─────────┤                                             ┼─────────┼─────────┼─────────├─────────┼─────────┼─────────┼
│         │    !    │    (    │    )    │    =    │    #    │                                             │         │  SHIFT  │  CTRL   │   ALT   │   GUI   │         │
├─────────┼─────────┼─────────┼─────────┼─────────┼─────────┼─────────╮                         ╭─────────┼─────────┼─────────┼─────────├─────────┼─────────┼─────────┼
│         │         │    {    │    }    │         │    \    │         │                         │         │         │         │         │         │         │         │
├─────────┼─────────┼─────────┼─────────┼─────────┼─────────┼─────────┼─────────╮     ╭─────────┼─────────┼─────────┼─────────┼─────────├─────────┼─────────┼─────────┼
│         │         │         │         │         │         │  SPACE  │         │     │         │┼┼┼┼┼┼┼┼┼┼         │         │         │         │         │         │
╰─────────┴─────────┴─────────╯         ╰─────────┴─────────┴─────────┴─────────╯     ╰─────────┴─────────┴─────────┴─────────╯         ╰─────────┴─────────┴─────────╯
*/
ZMK_LAYER(sym_layer,
// ╭────────────────────┬────────────────────┬────────────────────┬────────────────────┬────────────────────┬────────────────────╮                                                                                         ╭────────────────────┬────────────────────┬────────────────────┬────────────────────┬────────────────────┬────────────────────╮
     XXX                  &kp QUESTION         &kp LBKT             &kp RBKT             &kp COLON            &kp DOLLAR                                                                                                     XXX                  XXX                  XXX                  XXX                  XXX                  XXX
// ├────────────────────┼────────────────────┼────────────────────┼────────────────────┼────────────────────┼────────────────────┤                                                                                         ┼────────────────────┼────────────────────┼────────────────────├────────────────────┼────────────────────┼────────────────────┼
     XXX                  &kp EXCLAMATION      &kp LPAR             &kp RPAR             &kp EQUAL            &kp HASH                                                                                                       &kp LSHIFT           &kp RCTRL            &kp RALT             &kp RGUI             XXX                  XXX
// ├────────────────────┼────────────────────┼────────────────────┼────────────────────┼────────────────────┼────────────────────┼────────────────────╮                                               ╭────────────────────┼────────────────────┼────────────────────┼────────────────────├────────────────────┼────────────────────┼────────────────────┼
     XXX                  XXX                  &kp LBRC             &kp RBRC             XXX                  &kp BACKSLASH        XXX                                                                  XXX                  XXX                  XXX                  XXX                  XXX                  XXX                  XXX
// ├────────────────────┼────────────────────┼────────────────────┼────────────────────┼────────────────────┼────────────────────┼────────────────────┼────────────────────╮     ╭────────────────────┼────────────────────┼────────────────────┼────────────────────┼────────────────────├────────────────────┼────────────────────┼────────────────────┼
     XXX                  XXX                  XXX                                       XXX                  XXX                  &kp SPACE            XXX                        XXX                  XXX                  XXX                  XXX                                       XXX                  XXX                  XXX
// ╰────────────────────┴────────────────────┴────────────────────╯                    ╰────────────────────┴────────────────────┴────────────────────┴────────────────────╯     ╰────────────────────┴────────────────────┴────────────────────┴────────────────────╯                    ╰────────────────────┴────────────────────┴────────────────────╯
)

//* Math
/*
╭─────────┬─────────┬─────────┬─────────┬─────────┬─────────╮                                             ╭─────────┬─────────┬─────────┬─────────┬─────────┬─────────╮
│         │         │    <    │    >    │         │         │                                             │         │         │         │         │         │         │
├─────────┼─────────┼─────────┼─────────┼─────────┼─────────┤                                             ┼─────────┼─────────┼─────────├─────────┼─────────┼─────────┼
│         │         │    -    │    +    │    =    │         │                                             │         │  SHIFT  │  CTRL   │   ALT   │   GUI   │         │
├─────────┼─────────┼─────────┼─────────┼─────────┼─────────┼─────────╮                         ╭─────────┼─────────┼─────────┼─────────├─────────┼─────────┼─────────┼
│         │         │    /    │    *    │         │         │         │                         │         │         │         │         │         │         │         │
├─────────┼─────────┼─────────┼─────────┼─────────┼─────────┼─────────┼─────────╮     ╭─────────┼─────────┼─────────┼─────────┼─────────├─────────┼─────────┼─────────┼
│         │         │         │         │         │         │  SPACE  │         │     │|||||||||│         ┼         │         │         │         │         │         │
╰─────────┴─────────┴─────────╯         ╰─────────┴─────────┴─────────┴─────────╯     ╰─────────┴─────────┴─────────┴─────────╯         ╰─────────┴─────────┴─────────╯
*/
ZMK_LAYER(math_layer,
// ╭────────────────────┬────────────────────┬────────────────────┬────────────────────┬────────────────────┬────────────────────╮                                                                                         ╭────────────────────┬────────────────────┬────────────────────┬────────────────────┬────────────────────┬────────────────────╮
     XXX                  XXX                  &kp LT               &kp GT               XXX                  XXX                                                                                                            XXX                  XXX                  XXX                  XXX                  XXX                  XXX
// ├────────────────────┼────────────────────┼────────────────────┼────────────────────┼────────────────────┼────────────────────┤                                                                                         ┼────────────────────┼────────────────────┼────────────────────├────────────────────┼────────────────────┼────────────────────┼
     XXX                  XXX                  &kp MINUS            &kp PLUS             &kp EQUAL            XXX                                                                                                            &kp LSHIFT           &kp RCTRL            &kp RALT             &kp RGUI             XXX                  XXX
// ├────────────────────┼────────────────────┼────────────────────┼────────────────────┼────────────────────┼────────────────────┼────────────────────╮                                               ╭────────────────────┼────────────────────┼────────────────────┼────────────────────├────────────────────┼────────────────────┼────────────────────┼
     XXX                  XXX                  &kp SLASH            &kp ASTERISK         XXX                  XXX                  XXX                                                                  XXX                  XXX                  XXX                  XXX                  XXX                  XXX                  XXX
// ├────────────────────┼────────────────────┼────────────────────┼────────────────────┼────────────────────┼────────────────────┼────────────────────┼────────────────────╮     ╭────────────────────┼────────────────────┼────────────────────┼────────────────────┼────────────────────├────────────────────┼────────────────────┼────────────────────┼
     XXX                  XXX                  XXX                                       XXX                  XXX                  &kp SPACE            XXX                        XXX                  XXX                  XXX                  XXX                                       XXX                  XXX                  XXX
// ╰────────────────────┴────────────────────┴────────────────────╯                    ╰────────────────────┴────────────────────┴────────────────────┴────────────────────╯     ╰────────────────────┴────────────────────┴────────────────────┴────────────────────╯                    ╰────────────────────┴────────────────────┴────────────────────╯
)

//* Board
/*
╭─────────┬─────────┬─────────┬─────────┬─────────┬─────────╮                                             ╭─────────┬─────────┬─────────┬─────────┬─────────┬─────────╮
│ STUDIO  │         │         │   BT0   │   BT1   │   BT2   │                                             │         │         │         │         │         │         │
├─────────┼─────────┼─────────┼─────────┼─────────┼─────────┤                                             ┼─────────┼─────────┼─────────├─────────┼─────────┼─────────┼
│         │         │         │         │         │         │                                             │         │         │         │         │         │         │
├─────────┼─────────┼─────────┼─────────┼─────────┼─────────┼─────────╮                         ╭─────────┼─────────┼─────────┼─────────├─────────┼─────────┼─────────┼
│         │         │         │         │         │         │         │                         │┼┼┼┼┼┼┼┼┼│         │         │         │         │         │         │
├─────────┼─────────┼─────────┼─────────┼─────────┼─────────┼─────────┼─────────╮     ╭─────────┼─────────┼─────────┼─────────┼─────────├─────────┼─────────┼─────────┼
│         │         │         │         │         │         │         │         │     │         │         ┼         │         │         │         │         │         │
╰─────────┴─────────┴─────────╯         ╰─────────┴─────────┴─────────┴─────────╯     ╰─────────┴─────────┴─────────┴─────────╯         ╰─────────┴─────────┴─────────╯
*/
ZMK_LAYER(board_layer,
// ╭────────────────────┬────────────────────┬────────────────────┬────────────────────┬────────────────────┬────────────────────╮                                                                                         ╭────────────────────┬────────────────────┬────────────────────┬────────────────────┬────────────────────┬────────────────────╮
     &studio_unlock       XXX                  XXX                  &bt BT_SEL 0         &bt BT_SEL 1         &bt BT_SEL 2                                                                                                   XXX                  XXX                  XXX                  XXX                  XXX                  XXX
// ├────────────────────┼────────────────────┼────────────────────┼────────────────────┼────────────────────┼────────────────────┤                                                                                         ┼────────────────────┼────────────────────┼────────────────────├────────────────────┼────────────────────┼────────────────────┼
     XXX                  XXX                  XXX                  XXX                  XXX                  XXX                                                                                                            XXX                  XXX                  XXX                  XXX                  XXX                  XXX
// ├────────────────────┼────────────────────┼────────────────────┼────────────────────┼────────────────────┼────────────────────┼────────────────────╮                                               ╭────────────────────┼────────────────────┼────────────────────┼────────────────────├────────────────────┼────────────────────┼────────────────────┼
     XXX                  XXX                  XXX                  XXX                  XXX                  XXX                  XXX                                                                  XXX                  XXX                  XXX                  XXX                  XXX                  XXX                  XXX
// ├────────────────────┼────────────────────┼────────────────────┼────────────────────┼────────────────────┼────────────────────┼────────────────────┼────────────────────╮     ╭────────────────────┼────────────────────┼────────────────────┼────────────────────┼────────────────────├────────────────────┼────────────────────┼────────────────────┼
     XXX                  XXX                  XXX                                       XXX                  XXX                  XXX                  XXX                        XXX                  XXX                  XXX                  XXX                                       XXX                  XXX                  XXX
// ╰────────────────────┴────────────────────┴────────────────────╯                    ╰────────────────────┴────────────────────┴────────────────────┴────────────────────╯     ╰────────────────────┴────────────────────┴────────────────────┴────────────────────╯                    ╰────────────────────┴────────────────────┴────────────────────╯
)

//* Empty
/*
╭─────────┬─────────┬─────────┬─────────┬─────────┬─────────╮                                             ╭─────────┬─────────┬─────────┬─────────┬─────────┬─────────╮
│         │         │         │         │         │         │                                             │         │         │         │         │         │         │
├─────────┼─────────┼─────────┼─────────┼─────────┼─────────┤                                             ┼─────────┼─────────┼─────────├─────────┼─────────┼─────────┼
│         │         │         │         │         │         │                                             │         │         │         │         │         │         │
├─────────┼─────────┼─────────┼─────────┼─────────┼─────────┼─────────╮                         ╭─────────┼─────────┼─────────┼─────────├─────────┼─────────┼─────────┼
│         │         │         │         │         │         │         │                         |         │         │         │         │         │         │         │
├─────────┼─────────┼─────────┼─────────┼─────────┼─────────┼─────────┼─────────╮     ╭─────────┼─────────┼─────────┼─────────┼─────────├─────────┼─────────┼─────────┼
│         │         │         │         │         │         │         │         │     │         │         ┼         │         │         │         │         │         │
╰─────────┴─────────┴─────────╯         ╰─────────┴─────────┴─────────┴─────────╯     ╰─────────┴─────────┴─────────┴─────────╯         ╰─────────┴─────────┴─────────╯
*/
ZMK_LAYER(empty_layer,
// ╭────────────────────┬────────────────────┬────────────────────┬────────────────────┬────────────────────┬────────────────────╮                                                                                         ╭────────────────────┬────────────────────┬────────────────────┬────────────────────┬────────────────────┬────────────────────╮
     XXX                  XXX                  XXX                  XXX                  XXX                  XXX                                                                                                            XXX                  XXX                  XXX                  XXX                  XXX                  XXX
// ├────────────────────┼────────────────────┼────────────────────┼────────────────────┼────────────────────┼────────────────────┤                                                                                         ┼────────────────────┼────────────────────┼────────────────────├────────────────────┼────────────────────┼────────────────────┼
     XXX                  XXX                  XXX                  XXX                  XXX                  XXX                                                                                                            XXX                  XXX                  XXX                  XXX                  XXX                  XXX
// ├────────────────────┼────────────────────┼────────────────────┼────────────────────┼────────────────────┼────────────────────┼────────────────────╮                                               ╭────────────────────┼────────────────────┼────────────────────┼────────────────────├────────────────────┼────────────────────┼────────────────────┼
     XXX                  XXX                  XXX                  XXX                  XXX                  XXX                  XXX                                                                  XXX                  XXX                  XXX                  XXX                  XXX                  XXX                  XXX
// ├────────────────────┼────────────────────┼────────────────────┼────────────────────┼────────────────────┼────────────────────┼────────────────────┼────────────────────╮     ╭────────────────────┼────────────────────┼────────────────────┼────────────────────┼────────────────────├────────────────────┼────────────────────┼────────────────────┼
     XXX                  XXX                  XXX                                       XXX                  XXX                  XXX                  XXX                        XXX                  XXX                  XXX                  XXX                                       XXX                  XXX                  XXX
// ╰────────────────────┴────────────────────┴────────────────────╯                    ╰────────────────────┴────────────────────┴────────────────────┴────────────────────╯     ╰────────────────────┴────────────────────┴────────────────────┴────────────────────╯                    ╰────────────────────┴────────────────────┴────────────────────╯
)
